## package/rtl8723ds_mp_driver/Config.in
```kconfig
config BR2_PACKAGE_RTL8723DS_MP_DRIVER
	bool "rtl8723ds_mp_driver"
	depends on BR2_LINUX_KERNEL
	select BR2_PACKAGE_WIRELESS_TOOLS
	help
	  Linux kernel module for the MP Test with rtl8723ds SDIO WiFi module.

	  Make sure your target kernel has the following config
	  options enabled:

	    * CONFIG_MODULES: loadable module support
	    * CONFIG_CFG80211: cfg80211 wireless interface support

comment "rtl8723ds MP driver needs a Linux kernel to be built"
	depends on !BR2_LINUX_KERNEL

if BR2_PACKAGE_RTL8723DS_MP_DRIVER

choice
	prompt "RTL8723DS MP Driver Version"
	help
	  Select the specific RTL8723DS MP Driver version you want to use

config BR2_PACKAGE_RTL8723DS_MP_DRIVER_LATEST_VERSION
	bool "Latest Version from Git"

config BR2_PACKAGE_RTL8723DS_MP_DRIVER_CUSTOM_VERSION
	bool "Custom version"
	help
	  This option allows to use a specific official versions

config BR2_PACKAGE_RTL8723DS_MP_DRIVER_CUSTOM_GIT
	bool "Custom Git repository"

endchoice

config BR2_PACKAGE_RTL8723DS_MP_DRIVER_CUSTOM_VERSION_VALUE
	string "RTL8723DS MP Driver version"
	default "v5.1.1.2_18132.20160706_BTCOEX20160510-0909"
	depends on BR2_PACKAGE_RTL8723DS_MP_DRIVER_CUSTOM_VERSION

if BR2_PACKAGE_RTL8723DS_MP_DRIVER_CUSTOM_GIT

config BR2_PACKAGE_RTL8723DS_MP_DRIVER_CUSTOM_REPO_URL
	string "URL of custom repository"
	default BR2_PACKAGE_RTL8723DS_MP_DRIVER_CUSTOM_GIT_REPO_URL \
		if BR2_PACKAGE_RTL8723DS_MP_DRIVER_CUSTOM_GIT_REPO_URL != ""  # legacy

config BR2_PACKAGE_RTL8723DS_MP_DRIVER_CUSTOM_REPO_VERSION
	string "Custom repository version"
	default BR2_PACKAGE_RTL8723DS_MP_DRIVER_CUSTOM_GIT_VERSION \
		if BR2_PACKAGE_RTL8723DS_MP_DRIVER_CUSTOM_GIT_VERSION != ""  # legacy
	help
	  Revision to use in the typical format used by Git
	  E.G. a sha id, a tag, branch, ..

endif
endif

config BR2_PACKAGE_RTL8723DS_MP_DRIVER_VERSION
	string
	default "master" \
		if BR2_PACKAGE_RTL8723DS_MP_DRIVER_LATEST_VERSION
	default BR2_PACKAGE_RTL8723DS_MP_DRIVER_CUSTOM_VERSION_VALUE \
		if BR2_PACKAGE_RTL8723DS_MP_DRIVER_CUSTOM_VERSION
	default BR2_PACKAGE_RTL8723DS_MP_DRIVER_CUSTOM_REPO_VERSION \
		if BR2_PACKAGE_RTL8723DS_MP_DRIVER_CUSTOM_GIT
```
